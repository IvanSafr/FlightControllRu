/*
  Данный пример позволяет обмениваться текстовыми сообщениями между двумя компьютерами (или смартфонами с OTG), посредством радиомодулей от EBYTE.
  Для отправки и получения сообщений, используйте монитор порта ArduinoIDE на компьютере или соответствующую программу на смартфоне.
  Чтобы модули "слышали" друг друга, они должны быть настроены на одну частоту, скорость сети и т.д. Если пример не работает, установите настройки
  по умолчанию для всех модулей.
*/

#include <SoftwareSerial.h>
#include "EBYTE22.h"

// Константы для Arduino

#define PIN_TX 2
#define PIN_RX 3
#define PIN_M0 4
#define PIN_M1 5
#define PIN_AX 6

// Константы для плат на ESP8266
/*
#define PIN_RX 14
#define PIN_TX 12
#define PIN_M0 5
#define PIN_M1 4
#define PIN_AX 13
*/



SoftwareSerial E22Serial(PIN_TX, PIN_RX, false);        // Создаем объект SoftwareSerial для соединения с модулем через программный UART

EBYTE22 E22(&E22Serial, PIN_M0, PIN_M1, PIN_AX);        // Создаем экземпляр класса EBYTE22

void setup() {
 Serial.begin(9600);                       // Устанавливаем соединение с компьютером (телефоном) для отладки.
 E22Serial.begin(9600);                    // Устанавливаем соединение с модулем (скорость 9600).
 delay(5000);
 
  // При инициализации и некоторых других операциях (применение настроек, установка ключа), модуль переходит в режим конфигурации, в этом режиме UART модуля работает только на скорости 9600.
  if(E22.init())                           // Инициализируем модуль(конфигурируются выводы контроллера, считываются настройки модуля).
 {Serial.println("init OK");} else{
  Serial.println("init Error");}           // Если что-то пошло не так, выводим сообщение об ошибке.
 
// В случае ошибки, проверьте правильность подключения и перезапустите модуль с контроллером сбросом питания (кнопка сброса контроллера НЕ ПОМОГАЕТ).
   
}

void loop() {

     // Входящее сообщение
    if (E22.available() > 0) {          // Проверяем, есть ли непрочитанные данные в буфере программного UART (входящее сообщение от другого модуля). Если да, то:
     String s = E22Serial.readString(); // Считываем полученные данные в строку.
     Serial.println("New message.. ");  // Выводим в монитор порта уведомление о новом сообщении.
     Serial.println(s);                 // Выводим в монитор порта полученное сообщение.
     }

     // Исходящее сообщение
    if (Serial.available() > 0) {       // Проверяем, есть ли непрочитанные данные с монитора порта. Если да, то:
     String s = Serial.readString();    // Считываем полученные данные в строку.
     Serial.println("Send.. ");         // Выводим в монитор порта уведомление о передаче сообщения.
     Serial.println(s);                 // Выводим своё сообщение в монитор порта, чтобы видеть, что было отправлено.
     E22Serial.println(s);              // Отправляем строку на программный UART, к которому подключен модуль. Он в свою очередь передаст все данные по радиоканалу.
     }

}
